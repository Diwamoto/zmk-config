## boards/shields/sage60_ec/Kconfig.shield
```kconfig
# Copyright (c) 2023 Diwamoto_
# SPDX-License-Identifier: MIT

config SHIELD_SAGE60_EC_LEFT
	def_bool $(shields_list_contains,sage60_ec_left)
	select ADC
    select GPIO

config SHIELD_SAGE60_EC_RIGHT
	def_bool $(shields_list_contains,sage60_ec_right)
	select ADC
    select GPIO
```

## boards/shields/sage60_ec/boards/seeeduino_xiao_ble.conf
```kconfig
CONFIG_ZMK_KSCAN_EC_MATRIX_SETTINGS_DISCRETE=y
CONFIG_ZMK_KSCAN_EC_MATRIX_FAKE_OPEN_DRAIN=y
CONFIG_FLASH=y
CONFIG_FLASH_PAGE_LAYOUT=y
CONFIG_FLASH_MAP=y
CONFIG_MPU_ALLOW_FLASH_WRITE=y

CONFIG_NVS=y

CONFIG_SETTINGS=y
CONFIG_SETTINGS_NVS=y

CONFIG_ZMK_BEHAVIOR_LOCAL_ID_TYPE_CRC16=y
CONFIG_SETTINGS_NVS_SECTOR_COUNT=16
CONFIG_USB_CDC_ACM_RINGBUF_SIZE=256
```

## config/boards/shields/sage60_xiao/Kconfig.defconfig
```kconfig
# Copyright (c) 2023 Diwamoto_
# SPDX-License-Identifier: MIT

if SHIELD_SAGE60_XIAO_LEFT

config ZMK_KEYBOARD_NAME
	default "Sage60 Xiao"

config ZMK_SPLIT_ROLE_CENTRAL
	default y
	
endif

if SHIELD_SAGE60_XIAO_LEFT || SHIELD_SAGE60_XIAO_RIGHT

config ZMK_SPLIT
	default y

endif
```

## config/boards/shields/sage60_xiao/Kconfig.shield
```kconfig
# Copyright (c) 2023 Diwamoto_
# SPDX-License-Identifier: MIT

config SHIELD_SAGE60_XIAO_LEFT
	def_bool $(shields_list_contains,sage60_xiao_left)

config SHIELD_SAGE60_XIAO_RIGHT
	def_bool $(shields_list_contains,sage60_xiao_right)
```

## config/boards/shields/sage60_xiao_ec/Kconfig.defconfig
```kconfig
# Copyright (c) 2023 Diwamoto_
# SPDX-License-Identifier: MIT

if SHIELD_SAGE60_XIAO_EC_LEFT

config ZMK_KEYBOARD_NAME
	default "Sage60_Xiao_EC"

config ZMK_SPLIT_ROLE_CENTRAL
	default y
	
endif

if SHIELD_SAGE60_XIAO_EC_LEFT || SHIELD_SAGE60_XIAO_EC_RIGHT

config ZMK_SPLIT
	default y

endif
```

## west.yml
```yaml
manifest:
  remotes:
    - name: zmkfirmware
      url-base: https://github.com/zmkfirmware
    - name: petejohanson
      url-base: https://github.com/petejohanson
  projects:
    - name: zmk
      remote: zmkfirmware
      revision: main
      import: app/west.yml
    - name: ec-support-zmk-module
      remote: petejohanson
      revision: main
```
