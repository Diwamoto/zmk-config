/*
 * Copyright (c) 2023 Diwamoto_
 *
 * SPDX-License-Identifier: MIT
 */

#include "sage60_xiao.dtsi"

&kscan0 {
	col-gpios
		= <&xiao_d 2 GPIO_ACTIVE_HIGH>
        , <&xiao_d 3 GPIO_ACTIVE_HIGH>
        ;
};
