/*
* Copyright (c) 2021 The ZMK Contributors
*
* SPDX-License-Identifier: MIT
 */
// https://akizukidenshi.com/goodsaffix/AE-NRF52840.pdf
/ {
	pro_micro: connector {
		compatible = "arduino-pro-micro";
		#gpio-cells = <2>;
		gpio-map-mask = <0xffffffff 0xffffffc0>;
		gpio-map-pass-thru = <0 0x3f>;
		gpio-map 
				= <0 0 &gpio0 4 0>,	/* D14 A0 */
				<1 0 &gpio0 5 0>,	/* D15 A1 */
				<2 0 &gpio0 30 0>,	/* D16 A2 */
				<3 0 &gpio0 28 0>,	/* D17 A3 */
				<4 0 &gpio0 2 0>,	/* D18 A4 */
				<5 0 &gpio0 3 0>,	/* D19 A5 */
				<6 0 &gpio0 14 0>,	/* D26 SCK */
				<7 0 &gpio0 13 0>,	/* D25 MOSI */
				<8 0 &gpio0 15 0>,	/* D24 MISO */
				<9 0 &gpio0 24 0>,	/* D1 RXD */
				<10 0 &gpio0 25 0>,	/* D0 TXD */
				<11 0 &gpio0 10 0>,	/* D2 (NFC2) */
				<12 0 &gpio0 12 0>,	/* D22 SDA */
				<13 0 &gpio0 11 0>,	/* D23 SCL */
				<14 0 &gpio1 8 0>,	/* D5 */
				<15 0 &gpio0 7 0>,	/* D6 */
				<16 0 &gpio0 26 0>,	/* D9 */
				<17 0 &gpio0 27 0>,	/* D10 */
				<18 0 &gpio0 6 0>,	/* D11 */
				<19 0 &gpio0 8 0>,	/* D12 */
				<20 0 &gpio1 9 0>;	/* D13 */
	};
};