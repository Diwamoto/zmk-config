## config/boards/arm/ae_nrf52840/Kconfig.board
```kconfig
# ae_nrf52840 board configuration

# Copyright (c) 2020 Pete Johanson
# SPDX-License-Identifier: MIT

config BOARD_AE_NRF52840
	bool "ae_nrf52840"
	depends on SOC_NRF52840_QIAA
```

## config/boards/arm/ae_nrf52840/Kconfig.defconfig
```kconfig
# Copyright (c) 2021 The ZMK Contributors
# SPDX-License-Identifier: MIT

if BOARD_AE_NRF52840

config BOARD
	default "ae_nrf52840"

if USB_DEVICE_STACK

config USB_NRFX
	default y

endif # USB_DEVICE_STACK

config BT_CTLR
	default BT

endif # BOARD_AE_NRF52840
```

## config/boards/shields/poc_ec/Kconfig.defconfig
```kconfig
# Copyright (c) 2024 Diwamoto_
# SPDX-License-Identifier: MIT

if SHIELD_POC_EC_LEFT

config ZMK_KEYBOARD_NAME
	default "Poc_EC"

config ZMK_SPLIT_ROLE_CENTRAL
	default y
	
endif

if SHIELD_POC_EC_LEFT || SHIELD_POC_EC_RIGHT

config ZMK_SPLIT
	default y

endif
```

## config/boards/shields/poc_ec/Kconfig.shield
```kconfig
# Copyright (c) 2024 Diwamoto_
# SPDX-License-Identifier: MIT

config SHIELD_POC_EC_LEFT
	def_bool $(shields_list_contains,poc_ec_left)

config SHIELD_POC_EC_RIGHT
	def_bool $(shields_list_contains,poc_ec_right)
```

## config/boards/shields/sage60/Kconfig.shield
```kconfig
# Copyright (c) 2020 Ryan Cross
# SPDX-License-Identifier: MIT

config SHIELD_SAGE60_LEFT
	def_bool $(shields_list_contains,sage60_left)

config SHIELD_SAGE60_RIGHT
	def_bool $(shields_list_contains,sage60_right)
```

## config/boards/shields/sage60_ec/Kconfig.defconfig
```kconfig
# Copyright (c) 2023 Diwamoto_
# SPDX-License-Identifier: MIT

if SHIELD_SAGE60_EC_LEFT

config ZMK_KEYBOARD_NAME
	default "Sage60_EC"

config ZMK_SPLIT_ROLE_CENTRAL
	default y
	
endif

if SHIELD_SAGE60_EC_LEFT || SHIELD_SAGE60_EC_RIGHT

config ZMK_SPLIT
	default y

endif

config ZMK_KSCAN_DIRECT_POLLING
	bool
	default n
```

## config/dts/bindings/kscan/zmk,kscan-ec-matrix.yaml
```yaml
# Copyright (c) 2024 Diwamoto_
# SPDX-License-Identifier: MIT

description: GPIO keyboard matrix controller

compatible: "zmk,kscan-ec-matrix"

include: kscan.yaml

properties:
  row-gpios:
    type: phandle-array
    required: true
  sel-gpios:
    type: phandle-array
    required: true
  discharge-gpios:
    type: phandle-array
    required: true
  power-gpios:
    type: phandle-array
    required: true
  mux-en-gpios:
    type: phandle-array
    required: true
  col-channels:
    type: array
    required: true
  press-point:
    type: int
    default: 1000
  release-point:
    type: int
    default: 500
  io-channels:
    type: phandle-array
    required: true
```

## config/sage60_drivers/kscan/Kconfig
```kconfig
# Copyright (c) 2024 Diwamoto_
# SPDX-License-Identifier: MIT

DT_COMPAT_ZMK_KSCAN_EC_MATRIX := zmk,kscan-ec-matrix

config KSCAN_EC_MATRIX
    bool
    default $(dt_compat_enabled,$(DT_COMPAT_ZMK_KSCAN_EC_MATRIX))
    select ZMK_KSCAN_GPIO_DRIVER
    select ADC

	
```
